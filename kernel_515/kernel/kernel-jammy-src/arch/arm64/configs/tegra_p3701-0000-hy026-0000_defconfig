## kernel_515/kernel/kernel-jammy-src/drivers/net/dsa/mv88e6xxx/Kconfig
```kconfig
# SPDX-License-Identifier: GPL-2.0-only
config NET_DSA_MV88E6XXX
	tristate "Marvell 88E6xxx Ethernet switch fabric support"
	depends on NET_DSA
	select IRQ_DOMAIN
	select NET_DSA_TAG_EDSA
	select NET_DSA_TAG_DSA
	help
	  This driver adds support for most of the Marvell 88E6xxx models of
	  Ethernet switch chips, except 88E6060.

config NET_DSA_MV88E6XXX_PTP
	bool "PTP support for Marvell 88E6xxx"
	default n
	depends on (NET_DSA_MV88E6XXX = y && PTP_1588_CLOCK = y) || \
	           (NET_DSA_MV88E6XXX = m && PTP_1588_CLOCK)
	help
	  Say Y to enable PTP hardware timestamping on Marvell 88E6xxx switch
	  chips that support it.


config NET_DSA_MV88E6XXX_SIMPLIFIED_SWI_MGT
	tristate "simplified switch managment support"
	depends on NET_DSA_MV88E6XXX
	help
	  simplified switch managment support for Marvell 88E6xxx switch chip.
```
